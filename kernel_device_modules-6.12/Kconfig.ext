## kernel_device_modules-6.12/Kconfig.ext
```kconfig
# SPDX-License-Identifier: GPL-2.0

config CANNON_BRINGUP
	bool "Cannon MT6853 first-stage bring-up"
	help
	  Build the audited MT6853 clock and pinctrl module set instead of the
	  unconditional MT6895/xaga module list. Add other cannon subsystems
	  only after their device-tree bindings and dependencies are ported.

config CANNON_ION_COMPAT
	tristate "Cannon legacy ION handles over DMA heaps"
	depends on CANNON_BRINGUP && DMABUF_HEAPS
	help
	  Provide the 4.14 handle-based userspace ABI with real system DMA-BUF
	  allocations. MTK IOVA ioctls and protected heaps are not provided.

config DEVICE_MODULES_ALLOW_BUILTIN
	bool "allow builtin drivers into kernel image"
	help
	  All modules are default built as kernel modules.
	  Set DEVICE_MODULES_ALLOW_BUILTIN=y to build modules
	  into the kernel image.
	  If unsure, say N.

source "$(KCONFIG_EXT_PREFIX)drivers/memory/Kconfig"

source "$(KCONFIG_EXT_PREFIX)drivers/edac/Kconfig"

source "$(KCONFIG_EXT_PREFIX)drivers/iio/adc/Kconfig"

source "$(KCONFIG_EXT_PREFIX)drivers/mfd/Kconfig"

source "$(KCONFIG_EXT_PREFIX)drivers/nvmem/Kconfig"

source "$(KCONFIG_EXT_PREFIX)drivers/dma/mediatek/Kconfig"

source "$(KCONFIG_EXT_PREFIX)drivers/ufs/Kconfig"

source "$(KCONFIG_EXT_PREFIX)drivers/char/Kconfig"

source "$(KCONFIG_EXT_PREFIX)drivers/clk/mediatek/Kconfig"

source "$(KCONFIG_EXT_PREFIX)drivers/clocksource/Kconfig"

source "$(KCONFIG_EXT_PREFIX)drivers/cpufreq/Kconfig"

source "$(KCONFIG_EXT_PREFIX)drivers/soc/mediatek/Kconfig"

source "$(KCONFIG_EXT_PREFIX)drivers/watchdog/Kconfig"

source "$(KCONFIG_EXT_PREFIX)drivers/dma-buf/heaps/Kconfig"

source "$(KCONFIG_EXT_PREFIX)drivers/regulator/Kconfig"

source "$(KCONFIG_EXT_PREFIX)drivers/leds/Kconfig"

source "$(KCONFIG_EXT_PREFIX)drivers/pinctrl/mediatek/Kconfig"

source "$(KCONFIG_EXT_PREFIX)drivers/power/supply/Kconfig"

source "$(KCONFIG_EXT_PREFIX)drivers/rtc/Kconfig"

source "$(KCONFIG_EXT_PREFIX)drivers/remoteproc/Kconfig"

source "$(KCONFIG_EXT_PREFIX)drivers/rpmsg/Kconfig"

source "$(KCONFIG_EXT_PREFIX)drivers/input/keyboard/Kconfig"
source "$(KCONFIG_EXT_PREFIX)drivers/input/misc/Kconfig"

source "$(KCONFIG_EXT_PREFIX)drivers/phy/mediatek/Kconfig"

source "$(KCONFIG_EXT_PREFIX)drivers/thermal/mediatek/Kconfig"

source "$(KCONFIG_EXT_PREFIX)drivers/spmi/Kconfig"

source "$(KCONFIG_EXT_PREFIX)drivers/tty/serial/8250/Kconfig"

source "$(KCONFIG_EXT_PREFIX)drivers/reset/Kconfig"

source "$(KCONFIG_EXT_PREFIX)drivers/mailbox/Kconfig"

source "$(KCONFIG_EXT_PREFIX)drivers/interconnect/Kconfig"

source "$(KCONFIG_EXT_PREFIX)drivers/i2c/busses/Kconfig"

source "$(KCONFIG_EXT_PREFIX)drivers/i3c/master/Kconfig"

source "$(KCONFIG_EXT_PREFIX)drivers/pwm/Kconfig"

source "$(KCONFIG_EXT_PREFIX)drivers/spi/Kconfig"

source "$(KCONFIG_EXT_PREFIX)drivers/iommu/Kconfig"

source "$(KCONFIG_EXT_PREFIX)drivers/tee/Kconfig"

source "$(KCONFIG_EXT_PREFIX)drivers/mmc/host/Kconfig"

source "$(KCONFIG_EXT_PREFIX)drivers/gpu/drm/mediatek/Kconfig"

source "$(KCONFIG_EXT_PREFIX)drivers/input/touchscreen/Kconfig"

source "$(KCONFIG_EXT_PREFIX)drivers/gpu/drm/panel/Kconfig"

source "$(KCONFIG_EXT_PREFIX)drivers/gpu/drm/bridge/Kconfig"

source "$(KCONFIG_EXT_PREFIX)drivers/gpu/mediatek/Kconfig"

source "$(KCONFIG_EXT_PREFIX)drivers/media/platform/Kconfig"

source "$(KCONFIG_EXT_PREFIX)drivers/usb/mtu3/Kconfig"

source "$(KCONFIG_EXT_PREFIX)drivers/net/ethernet/stmicro/Kconfig"

source "$(KCONFIG_EXT_PREFIX)drivers/net/phy/Kconfig"

source "$(KCONFIG_EXT_PREFIX)drivers/devfreq/Kconfig"

source "$(KCONFIG_EXT_PREFIX)drivers/misc/Kconfig"

source "$(KCONFIG_EXT_PREFIX)sound/soc/codecs/Kconfig"

source "$(KCONFIG_EXT_PREFIX)sound/soc/mediatek/Kconfig"

source "$(KCONFIG_EXT_PREFIX)sound/virtio/Kconfig"

source "$(KCONFIG_EXT_PREFIX)drivers/pci/controller/Kconfig"

source "$(KCONFIG_EXT_PREFIX)drivers/pinctrl/Kconfig"

source "$(KCONFIG_EXT_PREFIX)drivers/media/platform/mtk-isp/Kconfig"

source "$(KCONFIG_EXT_PREFIX)fs/f2fs/Kconfig"

source "$(KCONFIG_EXT_PREFIX)arch/arm/Kconfig"
source "$(KCONFIG_EXT_PREFIX)arch/arm64/Kconfig"

source "$(KCONFIG_EXT_PREFIX)drivers/hypervisor/guest/Kconfig"

source "$(KCONFIG_EXT_PREFIX)drivers/hypervisor/host/Kconfig"

source "$(KCONFIG_EXT_PREFIX)drivers/hypervisor/nebula/Kconfig"

source "$(KCONFIG_EXT_PREFIX)/drivers/media/virtio/Kconfig"

source "$(KCONFIG_EXT_PREFIX)/drivers/video/backlight/Kconfig"

source "$(KCONFIG_EXT_PREFIX)/drivers/trusty/Kconfig"
```

## kernel_device_modules-6.12/drivers/char/rpmb/Kconfig
```kconfig
config MTK_RPMB
	tristate "RPMB partition interface"
	help
	  Unified RPMB partition interface for eMMC and UFS.
	  Provides interface for in kernel security controllers to
	  access RPMB partition.

	  If unsure, select N.

config RPMB_INTF_DEV
	bool "RPMB character device interface /dev/rpmbN"
	depends on MTK_RPMB
	help
	  Say yes here if you want to access RPMB partition
	  from user space via character device interface /dev/rpmbN

	  If unsure, select N.
```

## kernel_device_modules-6.12/drivers/input/fingerprint/Kconfig
```kconfig
config CANNON_FPC1022
	tristate "Cannon FPC1022 TEE fingerprint resources"
	depends on CANNON_BRINGUP && SPI && GPIOLIB && INPUT && REGULATOR
	help
	  Electrical resources, chip identification and IRQ/sysfs ABI for the
	  original Cannon FPC1022 HAL. Biometric processing stays in the TEE.
```

## kernel_device_modules-6.12/drivers/input/keyboard/Kconfig
```kconfig
# SPDX-License-Identifier: GPL-2.0-only
#
# Input core configuration
#

if INPUT_KEYBOARD

config KEYBOARD_MTK_KPD
	tristate "MediaTek Keypad Support"
	depends on OF && HAVE_CLK
	help
	  Say Y here if you want to use the keypad on MediaTek SoCs.
	  If unsure, say N.
	  To compile this driver as a module, choose M here: the
	  module will be called mtk-kpd.

config DEVICE_MODULES_KEYBOARD_MTK_PMIC
	tristate "MediaTek PMIC keys support"
	depends on DEVICE_MODULES_MFD_MT6397
	help
	  Say Y here if you want to use the pmic keys (powerkey/homekey).

	  To compile this driver as a module, choose M here: the
	  module will be called mtk-pmic-keys.

endif

config CANNON_POWERKEY_PANIC
	bool "Cannon debug: short power key press triggers panic"
	depends on CANNON_BRINGUP && DEVICE_MODULES_KEYBOARD_MTK_PMIC
	default n
	help
	  Trigger panic on a pressed KEY_POWER interrupt to preserve ramoops
	  across a warm restart. Debug images only. Full IRQ/bus lockups also
	  need a hardware watchdog. Can be disabled with the module parameter
	  mtk_pmic_keys.powerkey_panic=0.
```

## kernel_device_modules-6.12/drivers/input/touchscreen/Kconfig
```kconfig
# SPDX-License-Identifier: GPL-2.0-only
#
# Touchscreen driver configuration
#

if INPUT_TOUCHSCREEN

config TOUCHSCREEN_MTK_TOUCH
       string "Touch IC name for Mediatek package"
       help
         Set touch IC name if you have touch panel.

         To compile this dirver for used touch IC.

config TOUCHSCREEN_MT6985_ALPHA_SUPPORT
       tristate "Specify Alpha Touch Platform is mt6985"
       help
         Select Alpha Touch Platform is mt6985.
         To compile this dirver for used touch IC.
         Set Y or M to select this feature for specific platform-mt6985,
         and set N to disable.

config TOUCHSCREEN_ILITEK_TOUCH
       tristate "ILITEK TOUCHSCREEN"
       help
         Set Y or M to select this feature for touch compile,
         and set N to disable.

config TOUCHSCREEN_BOTAI_MULTI_TOUCH
       tristate "GT9XX MULTIPLE TOUCHSCREEN"
       help
         Set Y or M to select this feature for touch compile,
         and set N to disable.for BoTai touch feature.

config TOUCHSCREEN_GT9XX
       tristate "GT9XX TOUCHSCREEN FOR CAR SERDES TOUCH"
       help
         Set Y or M to select this feature for touch compile,
         and set N to disable.for car serdes touch feature.

# source "$(KCONFIG_EXT_PREFIX)drivers/input/touchscreen/BoTai_Multi_Touch/Kconfig"
# source "$(KCONFIG_EXT_PREFIX)drivers/input/touchscreen/GT9966/Kconfig"
# source "$(KCONFIG_EXT_PREFIX)drivers/input/touchscreen/gt9xx/Kconfig"
source "$(KCONFIG_EXT_PREFIX)drivers/input/touchscreen/ILITEK/Kconfig"
# source "$(KCONFIG_EXT_PREFIX)drivers/input/touchscreen/synaptics_dsx_96789/Kconfig"
# source "$(KCONFIG_EXT_PREFIX)drivers/input/touchscreen/synaptics_dsx_96851/Kconfig"
# source "$(KCONFIG_EXT_PREFIX)drivers/input/touchscreen/NT36532/Kconfig"
source "$(KCONFIG_EXT_PREFIX)drivers/input/touchscreen/xiaomi/Kconfig"

config TOUCHSCREEN_XIAOMI_DOUBLE_CLICK
	tristate "Xiaomi touch double-click state provider"
	help
	  Provides is_tp_doubleclick_enable()/tp_enable_doubleclick() used by
	  the touch panel and display panel drivers (ported from 5.10 xaga).

config TOUCHSCREEN_NVT36672C_HOSTDL_SPI
	tristate  "Novatek NT36xxx host download SPI driver"
	help
	  Say Y here if you have a Novatek NT36xxx no flash touchscreen connected
	  to your system by SPI bus.

	  If unsure, say N.

config TOUCHSCREEN_NVT36672C_DOUBLE_CLICK
	tristate "double click for nvt36672c"
	default n

config TOUCHSCREEN_CANNON_NT36672A
	bool "Cannon NT36672A board protocol"
	depends on TOUCHSCREEN_NVT36672C_HOSTDL_SPI
	help
	  Use Cannon's 65-byte NT36672A packet format and hardware reset.
	  Firmware names and the board wiring are provided by the device tree.

config MI_DISP_ESD_CHECK
	bool "Enable display ESD check recovery"
	default n
	help
	  Trigger panel dead flag on touch ESD detection to recover display.

endif
```
